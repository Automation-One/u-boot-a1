// SPDX-License-Identifier: GPL-2.0
/*
 * Copyright (C) 2019 Kontron Electronics GmbH
 */

/*
 * In U-Boot, we don't differentiate the LVDS variant, but we still need to
 * set the model and compatible string correctly to let the SPL select it
 * and pass it to the menu selection code in U-Boot.
 */

#include "imx8mm-kontron-n8010-rev0-s.dts"

/ {
	model = "Kontron i.MX8MM N8010 Rev0 S LVDS";
	compatible = "kontron,imx8mm-n8010-rev0-s-lvds", "fsl,imx8mm";
};
